## conf/layer.conf
```bitbake
# We have a conf and classes directory, add to BBPATH
BBPATH .= ":${LAYERDIR}"

# We have recipes-* directories, add to BBFILES
BBFILES += "${LAYERDIR}/recipes-*/*/*.bb \
            ${LAYERDIR}/recipes-*/*/*.bbappend"

BBFILE_COLLECTIONS += "doubleopen"
BBFILE_PATTERN_doubleopen = "^${LAYERDIR}/"
BBFILE_PRIORITY_doubleopen = "6"

LAYERDEPENDS_doubleopen = "core"
LAYERSERIES_COMPAT_doubleopen = "gatesgarth zeus dunfell"
```
